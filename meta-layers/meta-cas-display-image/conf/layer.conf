## meta-layers/meta-cas-display-image/conf/layer.conf
```bitbake
# We have a conf and classes directory, add to BBPATH
BBPATH .= ":${LAYERDIR}"

# We have recipes-* directories, add to BBFILES
BBFILES += "${LAYERDIR}/recipes-*/*/*.bb \
            ${LAYERDIR}/recipes-*/*/*.bbappend"

BBFILE_COLLECTIONS += "meta-cs-display-image"
BBFILE_PATTERN_meta-cs-display-image = "^${LAYERDIR}/"
BBFILE_PRIORITY_meta-cs-display-image = "6"

LAYERDEPENDS_meta-cs-display-image = "core"
LAYERSERIES_COMPAT_meta-cs-display-image = "kirkstone"
```

## meta-layers/meta-cas-display-image/conf/machine/dk2-mp1.conf
```bitbake
require conf/machine/stm32mp1.conf

# Ethernet over USB
KERNEL_MODULE_AUTOLOAD += "libcomposite"
```
